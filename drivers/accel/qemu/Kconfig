## drivers/accel/qemu/Kconfig
```kconfig
# SPDX-License-Identifier: GPL-2.0-only
#
# Qualcomm Cloud AI accelerators driver
#

config DRM_ACCEL_QEMU
	tristate "QEMU AI accelerators"
	depends on DRM_ACCEL
	depends on PCI && HAS_IOMEM
	depends on MMU
	select CRC32
	help
	  Enables driver for Qemu's AI accelerator PCIe cards that are
	  designed to accelerate Deep Learning inference workloads.

	  The driver manages the PCIe devices and provides an IOCTL interface
	  for users to submit workloads to the devices.

	  If unsure, say N.

	  To compile this driver as a module, choose M here: the
	  module will be called qemu_edu.
```
